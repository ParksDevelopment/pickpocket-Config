## boards/shields/PickPocket/Kconfig.shield
```kconfig
config SHIELD_PICKPOCKET_LEFT
    def_bool $(shields_list_contains,PickPocket_left)
config SHIELD_PICKPOCKET_RIGHT
    def_bool $(shields_list_contains,PickPocket_right)
```

## config/boards/shields/PickPocket/Kconfig.defconfig
```kconfig
if SHIELD_PICKPOCKET_LEFT

config ZMK_KEYBOARD_NAME
    default "PickPocket"

config ZMK_SPLIT_ROLE_CENTRAL
    default y

endif

if SHIELD_PICKPOCKET_LEFT || SHIELD_PICKPOCKET_RIGHT

config ZMK_SPLIT
    default y

endif
```
